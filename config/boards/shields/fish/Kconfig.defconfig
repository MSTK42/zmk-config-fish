## config/boards/shields/fish/Kconfig.defconfig
```kconfig
# Copyright (c) 2021 The ZMK Contributors
# SPDX-License-Identifier: MIT

if SHIELD_FISH_LEFT
# 通常運用: 左がcentral
config ZMK_SPLIT_ROLE_CENTRAL
    default y
endif

if SHIELD_FISH_LEFT || SHIELD_FISH_RIGHT || SHIELD_FISH_LEFT_DONGLE || SHIELD_FISH_RIGHT_DONGLE

config ZMK_SPLIT
    default y

config ZMK_KEYBOARD_NAME
    default "FISH"

endif

if SHIELD_FISH_DONGLE

config ZMK_KEYBOARD_NAME
    default "FISH"

config ZMK_SPLIT_ROLE_CENTRAL
    default y

config ZMK_SPLIT
    default y

# 左右だけなので 2
config ZMK_SPLIT_BLE_CENTRAL_PERIPHERALS
    default 3

# 2 peripherals + ホスト接続用
config BT_MAX_CONN
    default 8

config BT_MAX_PAIRED
    default 8

endif
```

## config/west.yml
```yaml
manifest:
  remotes:
    - name: zmkfirmware
      url-base: https://github.com/zmkfirmware
    - name: carrefinho
      url-base: https://github.com/carrefinho
    - name: oleksandrmaslov
      url-base: https://github.com/oleksandrmaslov
    - name: ssbb
      url-base: https://github.com/ssbb
    - name: kot149
      url-base: https://github.com/kot149
      
  projects:
    - name: zmk
      remote: zmkfirmware
      revision: main
      import: app/west.yml
      
    - name: prospector-zmk-module
      remote: carrefinho
      revision: feat/new-status-screens

    - name: zmk-pointing-acceleration
      remote: oleksandrmaslov
      revision: main

    - name: zmk-listeners
      remote: ssbb
      revision: v1
      path: modules/zmk-listeners

    - name: zmk-mouse-gesture
      remote: kot149
      revision: v1
      path: modules/zmk-mouse-gesture
      
  self:
    path: config
```
