#include <dt-bindings/zmk/matrix_transform.h>
#include "fish.dtsi"

/ {
    chosen {
        zmk,kscan = &nape_kscan;
    };

    nape_kscan: kscan {
        compatible = "zmk,kscan-gpio-direct";
        label = "nape_kscan";

        input-gpios =
            <&xiao_d 10 (GPIO_PULL_UP | GPIO_ACTIVE_LOW)>,  // 表面 左キー
            <&xiao_d 9  (GPIO_PULL_UP | GPIO_ACTIVE_LOW)>,  // 表面 中央キー
            <&xiao_d 8  (GPIO_PULL_UP | GPIO_ACTIVE_LOW)>;  // 表面 右キー
    };
};

&default_transform {
    col-offset = <8>;
};
